# file: 04-RTOS-Queue.ioc
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FREERTOS.Queues01=Queue01,5,uint16_t,0,Dynamic,NULL,NULL
FREERTOS.Tasks01=Task_Tx,32,128,Sender,Default,NULL,Dynamic,NULL,NULL;Task_RX,16,128,Reciver,Default,NULL,Dynamic,NULL,NULL;Task2_Tx,32,128,Sender2,Default,NULL,Dynamic,NULL,NULL
Mcu.Family=STM32F4
Mcu.Name=STM32F407V(E-G)Tx
Mcu.Package=LQFP100
NVIC.PriorityGroup=NVIC_PRIORITYGROUP_4
PH0-OSC_IN.Mode=HSE-External-Oscillator
PH0-OSC_IN.Signal=RCC_OSC_IN
PH1-OSC_OUT.Mode=HSE-External-Oscillator
PH1-OSC_OUT.Signal=RCC_OSC_OUT
ProjectManager.HeapSize=0x200
ProjectManager.StackSize=0x400
ProjectManager.TargetToolchain=STM32CubeIDE
RCC.48MHZClocksFreq_Value=48000000
RCC.AHBFreq_Value=168000000
RCC.APB1CLKDivider=RCC_HCLK_DIV4
RCC.APB1Freq_Value=42000000
RCC.APB1TimFreq_Value=84000000
RCC.APB2CLKDivider=RCC_HCLK_DIV2
RCC.APB2Freq_Value=84000000
RCC.APB2TimFreq_Value=168000000
RCC.CortexFreq_Value=168000000
RCC.HCLKFreq_Value=168000000
RCC.HSE_VALUE=8000000
RCC.HSI_VALUE=16000000
RCC.LSE_VALUE=32768
RCC.PLLM=8
RCC.PLLN=336
RCC.PLLQ=7
RCC.PLLSourceVirtual=RCC_PLLSOURCE_HSE
RCC.SYSCLKFreq_VALUE=168000000
RCC.SYSCLKSource=RCC_SYSCLKSOURCE_PLLCLK
RCC.VCOOutputFreq_Value=336000000
VP_FREERTOS_VS_CMSIS_V2.Mode=CMSIS_V2
board=STM32F407G-DISC1

// file: Core/Src/main.c
/* USER CODE BEGIN Header */
/**
  ******************************************************************************
  * @file           : main.c
  * @brief          : Main program body
  ******************************************************************************
  * @attention
  *
  * Copyright (c) 2026 STMicroelectronics.
  * All rights reserved.
  *
  * This software is licensed under terms that can be found in the LICENSE file
  * in the root directory of this software component.
  * If no LICENSE file comes with this software, it is provided AS-IS.
  *
  ******************************************************************************
  */
/* USER CODE END Header */
#include "main.h"
#include "cmsis_os.h"

/* USER CODE BEGIN Includes */
#include "stdio.h"
#include "string.h"
/* USER CODE END Includes */

/* Definitions for Task_Tx */
osThreadId_t Task_TxHandle;
const osThreadAttr_t Task_Tx_attributes = {
  .name = "Task_Tx",
  .stack_size = 128 * 4,
  .priority = (osPriority_t) osPriorityAboveNormal,
};
/* Definitions for Task_RX */
osThreadId_t Task_RXHandle;
const osThreadAttr_t Task_RX_attributes = {
  .name = "Task_RX",
  .stack_size = 128 * 4,
  .priority = (osPriority_t) osPriorityBelowNormal,
};
/* Definitions for Task2_Tx */
osThreadId_t Task2_TxHandle;
const osThreadAttr_t Task2_Tx_attributes = {
  .name = "Task2_Tx",
  .stack_size = 128 * 4,
  .priority = (osPriority_t) osPriorityAboveNormal,
};
/* Definitions for Queue01 */
osMessageQueueId_t Queue01Handle;
const osMessageQueueAttr_t Queue01_attributes = {
  .name = "Queue01"
};

void SystemClock_Config(void);
static void MX_GPIO_Init(void);
void Sender(void *argument);
void Reciver(void *argument);
void Sender2(void *argument);

/* USER CODE BEGIN 0 */
int _write(int file, char *ptr, int len)
{
    for (int i = 0; i < len; i++)
    {
        ITM_SendChar((*ptr++));
    }
    return len;
}

/* USER CODE END 0 */

int main(void)
{

  /* MCU Configuration--------------------------------------------------------*/

  /* Reset of all peripherals, Initializes the Flash interface and the Systick. */
  HAL_Init();

  /* Configure the system clock */
  SystemClock_Config();

  /* Initialize all configured peripherals */
  MX_GPIO_Init();

  /* Init scheduler */
  osKernelInitialize();

  /* Create the queue(s) */
  /* creation of Queue01 */
  Queue01Handle = osMessageQueueNew (5, sizeof(uint16_t), &Queue01_attributes);

  /* Create the thread(s) */
  /* creation of Task_Tx */
  Task_TxHandle = osThreadNew(Sender, NULL, &Task_Tx_attributes);

  /* creation of Task_RX */
  Task_RXHandle = osThreadNew(Reciver, NULL, &Task_RX_attributes);

  /* creation of Task2_Tx */
  Task2_TxHandle = osThreadNew(Sender2, NULL, &Task2_Tx_attributes);

  /* Start scheduler */
  osKernelStart();

  /* We should never get here as control is now taken by the scheduler */

  /* Infinite loop */
  while (1)
  {

  }
}

void SystemClock_Config(void)
{
  RCC_OscInitTypeDef RCC_OscInitStruct = {0};
  RCC_ClkInitTypeDef RCC_ClkInitStruct = {0};

  /** Configure the main internal regulator output voltage
  */
  __HAL_RCC_PWR_CLK_ENABLE();
  __HAL_PWR_VOLTAGESCALING_CONFIG(PWR_REGULATOR_VOLTAGE_SCALE1);

  /** Initializes the RCC Oscillators according to the specified parameters
  * in the RCC_OscInitTypeDef structure.
  */
  RCC_OscInitStruct.OscillatorType = RCC_OSCILLATORTYPE_HSE;
  RCC_OscInitStruct.HSEState = RCC_HSE_ON;
  RCC_OscInitStruct.PLL.PLLState = RCC_PLL_ON;
  RCC_OscInitStruct.PLL.PLLSource = RCC_PLLSOURCE_HSE;
  RCC_OscInitStruct.PLL.PLLM = 8;
  RCC_OscInitStruct.PLL.PLLN = 336;
  RCC_OscInitStruct.PLL.PLLP = RCC_PLLP_DIV2;
  RCC_OscInitStruct.PLL.PLLQ = 7;
  if (HAL_RCC_OscConfig(&RCC_OscInitStruct) != HAL_OK)
  {
    Error_Handler();
  }

  /** Initializes the CPU, AHB and APB buses clocks
  */
  RCC_ClkInitStruct.ClockType = RCC_CLOCKTYPE_HCLK|RCC_CLOCKTYPE_SYSCLK
                              |RCC_CLOCKTYPE_PCLK1|RCC_CLOCKTYPE_PCLK2;
  RCC_ClkInitStruct.SYSCLKSource = RCC_SYSCLKSOURCE_PLLCLK;
  RCC_ClkInitStruct.AHBCLKDivider = RCC_SYSCLK_DIV1;
  RCC_ClkInitStruct.APB1CLKDivider = RCC_HCLK_DIV4;
  RCC_ClkInitStruct.APB2CLKDivider = RCC_HCLK_DIV2;

  if (HAL_RCC_ClockConfig(&RCC_ClkInitStruct, FLASH_LATENCY_5) != HAL_OK)
  {
    Error_Handler();
  }
}

static void MX_GPIO_Init(void)
{

  /* GPIO Ports Clock Enable */
  __HAL_RCC_GPIOH_CLK_ENABLE();

}

void Sender(void *argument)
{
  /* USER CODE BEGIN 5 */
  /* Infinite loop */
	uint16_t value = 100;
  for(;;)
  {
	  printf("Sending Task 1\r\n");
	  osMessageQueuePut(Queue01Handle, &value, 0, 200);
	  value = value+10;
    osDelay(500);
  }
  /* USER CODE END 5 */
}

void Reciver(void *argument)
{
  /* USER CODE BEGIN Reciver */
  /* Infinite loop */
	uint16_t rx_data;
  for(;;)
  {
	  printf("Ready to Receive\r\n");
	  osMessageQueueGet(Queue01Handle, &rx_data, NULL, 2000);
	  printf("Data Accessed : %d\r\n", rx_data);
      osDelay(3000);
  }
  /* USER CODE END Reciver */
}

void Sender2(void *argument)
{
  /* USER CODE BEGIN Sender2 */
  /* Infinite loop */
  for(;;)
  {
	  uint16_t Tx_2;
	  printf("Sending Task 2\r\n");
	  osMessageQueuePut(Queue01Handle, &Tx_2, 50, 250);
	  Tx_2 = Tx_2*2;
    osDelay(1000);
  }
  /* USER CODE END Sender2 */
}

void Error_Handler(void)
{
  __disable_irq();
  while (1)
  {
  }
}
